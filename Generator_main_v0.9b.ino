#include <Wire.h>  // Only needed for Arduino 1.6.5 and earlier
#include "SSD1306.h" // alias for `#include "SSD1306Wire.h"`

// Include the UI lib
#include "OLEDDisplayUi.h"

// Include custom bitmaps
#include "bitmaps.h"

#define NUM_SAMPLES  1680    // Waveform tables length. Reduce to get more freq
#define MAX_WAVE_TYPES 4      // Number of waveform tables

// Following values are intended for two channels device
volatile int wave_type[] = {3, 3};   //(0:sine, triag, saw, sqr)
volatile int frequency[] = {2, 2};   // decimal (1--) to // Hz (by-10)(1-10) //~(0 is casted to 1)
volatile float amplitude[] = {0.5f, 0.5f}; // decimal (0-1) to %
volatile int phase[] = {0, 0};       // ° // (by-10)(-18,18)

volatile int iteratorA = 0, iteratorB = 0;  // Iterators for filling
volatile byte optTop = 0, optMain = 0;       // Menu options
volatile long last_touch_time = 0;           // Last registered touch
byte touch_threshold = 400;                  // Threshold for touch event
byte threshold = 30;                   // Threshold for touch sensor
bool onTouch = false;
byte onTouchData = 0;

SSD1306  display(0x3c, 18, 19);

OLEDDisplayUi ui ( &display );

static byte WaveFormTable[MAX_WAVE_TYPES][NUM_SAMPLES] = {
  //SINE, TRIANG, SAWTOOTH, SQUARE
  { 0x80,0x80,0x80,0x81,0x81,0x82,0x82,0x83,0x83,0x84,0x84,0x85,0x85,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0x7F,},
  { 0x00,0x00,0x01,0x01,0x01,0x02,0x02,0x02,0x02,0x03,0x03,0x03,0x04,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0x00,},
  { 0x00,0x00,0x00,0x00,0x01,0x01,0x01,0x01,0x01,0x01,0x02,0x02,0x02,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0xFF,},
  { 0x00,0x00,0x00,0x00,0x00,0x00,0x00,0x00,0x00,0x00,0x00,0x00,0x00,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0xFF,}
};

/* SELECTORS */
void tchTopMenuSelector(){
  onTouch = true;
  onTouchData = 0;
}

void tchMainMenuSelector(){
  onTouch = true;
  onTouchData = 1;
}

void tchIncrementVal(){
  onTouch = true;
  onTouchData = 2;
}

void tchDecrementVal(){
  onTouch = true;
  onTouchData = 3;
}

void changeVal(bool dec) {
  int inc = 1;
  
  if(dec) inc = -1;
  
  if(optTop < 2){
    switch(optMain) {
      case 0: {
        wave_type[optTop] = wave_type[optTop] + inc;
        if(wave_type[optTop] > 3) wave_type[optTop] = 0;
        if(wave_type[optTop] < 0) wave_type[optTop] = 3;
        break;
      };
      case 1: {
        frequency[optTop] = frequency[optTop] + inc;
        //if(frequency[optTop] > 10) frequency[optTop] = 1; //max w/o distort, recalibrate if resampled
        if(frequency[optTop] < 2) frequency[optTop] = 2;
        break;
      };
      case 2: {
        amplitude[optTop] = amplitude[optTop] + inc*0.05f;
        if(amplitude[optTop] > 1.6f) amplitude[optTop] = 0.0f;
        if(amplitude[optTop] < -0.01f) amplitude[optTop] = 1.6f;
        break;
      };
      case 3: {
        phase[optTop] = phase[optTop] + inc*10;
        if(phase[optTop] > NUM_SAMPLES) phase[optTop] = 0;
        if(phase[optTop] < 0) phase[optTop] = NUM_SAMPLES;
        break;
      };
    }
  }
}

void drawCChannel(){
  int N = mcm(ceil(NUM_SAMPLES/frequency[0]), ceil(NUM_SAMPLES/frequency[1]));
  int V[N];
  int j = 0;
  int k = 0;
  int m = 0;
  
  for(int i = 0; i < N; i++) {
    V[i] = amplitude[0]*WaveFormTable[wave_type[0]][j] + amplitude[1]*WaveFormTable[wave_type[1]][k + phase[1]];
    
    j += frequency[0];
    k += frequency[1];
    
    if (j >= NUM_SAMPLES) j = 0; 
    if (k >= NUM_SAMPLES - phase[1]) k = -phase[1];
  }  

  for(int n = 0; n < 128; n++){
    display.setPixel(n, 63 - 47*V[(int)(n*N/128)]/255);
    //N has to change in case of overmix
    
    //if(n % 18 == 0) display.drawLine(n, 40, n+9, 40);    
    //display.drawString(7, 35, "0V");
  }
}

volatile void redrawScreen() {  
  // clear the display
  display.clear();
  
  drawTopMenu();
  if(optTop < 2){
    drawMainMenu();
  } else {
    drawCChannel();
  }

  display.setColor(WHITE); 
  //dibujamos linea horizontal
  for(int i = 0; i < 32; i++)
    display.drawLine(4*i, 39, 4*i + 2, 39);

  for(int i = 0; i < 24; i++)
    display.drawLine(4*i, 15, 4*i + 2, 15);
    
  //dibujamos linea vertical 
  for(int i = 0; i < 16; i++)
    display.drawLine(64, 4*i, 64, 4*i + 2);

  for(int i = 0; i < 4; i++) {
    display.drawLine(31, 4*i, 31, 4*i + 2);
    display.drawLine(96, 4*i, 96, 4*i + 2);
  }
  
  display.display();
}

void drawTopMenu() {
  display.setColor(WHITE);
  
  display.drawXbm(10, 1, 12, 12, white_A);
  display.drawXbm(42, 1, 12, 12, white_B);
  display.drawXbm(74, 1, 12, 12, white_C);
  
  display.fillRect(optTop*32, 0, 32, 16);
  
  display.setColor(BLACK);
  if(optTop == 0) display.drawXbm(10 + optTop*32, 2, 12, 12, white_A);
  if(optTop == 1) display.drawXbm(10 + optTop*32, 2, 12, 12, white_B);
  if(optTop == 2) display.drawXbm(10 + optTop*32, 2, 12, 12, white_C);
  
  display.setColor(WHITE);
}

void drawMainMenu() {
  char signal_icon[64] = {};
  display.setColor(WHITE);

  switch (wave_type[optTop]) {
    case 0: {
      memcpy(signal_icon, sine_icon, 64);
      break;
    };
    case 1: {
      memcpy(signal_icon, tri_icon, 64);
      break;
    };
    case 2: {
      memcpy(signal_icon, saw_icon, 64);
      break;
    };
    case 3: {
      memcpy(signal_icon, sqr_icon, 64);
      break;
    };
  }
  display.drawXbm(16, 20, 32, 16, signal_icon);
  display.drawString(96, 20, (String) ((84000/NUM_SAMPLES)*frequency[optTop]) + " Hz"); //TODO: f mult currentfreq, see notes
  display.drawString(32, 46, (String) (3200*amplitude[optTop]) + " mV");
  if(optTop != 0 && optMain != 3) 
    display.drawString(96, 46, (String) (360.0f/NUM_SAMPLES*phase[optTop]) + "°");

  switch(optMain){
    case 0: {
      display.fillRect(0, 16, 64, 24);       
      display.setColor(BLACK);
      display.drawXbm(16, 20, 32, 16, signal_icon);
      break;
    };
    case 1: {
      display.fillRect(64, 16, 64, 24);   
      display.setColor(BLACK);    
      display.drawString(96, 20, (String) ((84000/NUM_SAMPLES)*frequency[optTop]) + " Hz");
      break;
    };
    case 2: {
      display.fillRect(0, 40, 64, 24);
      display.setColor(BLACK);  
      display.drawString(32, 46, (String) (3200*amplitude[optTop]) + " mV");  
      break;
    };
    case 3: {        
      display.fillRect(64, 40, 64, 24);
      display.setColor(BLACK);   
      display.drawString(96, 46, (String) (360.0f/NUM_SAMPLES*phase[optTop]) + "°");
      break;
    };
  }
}

/*
Método para hallar el Máximo Común Divisor
*/
int mcd(int num1, int num2) {
    int mcd = 0;
    int a = max(num1, num2);
    int b = min(num1, num2);
    do {
        mcd = b;
        b = a%b;
        a = mcd;
    } while(b!=0);
    return mcd;
}
 
/*
Método para hallar el Mínimo Común Múltiplo
*/
int mcm(int num1, int num2) {
    int mcm = 0;
    int a = max(num1, num2);
    int b = min(num1, num2);
    mcm = (a/mcd(a,b))*b;
    return mcm;
}

void setup() {
  Serial.begin(115200);

  // Initialising the UI will init the display too.
  display.init();
  
  display.flipScreenVertically();

  display.setTextAlignment(TEXT_ALIGN_CENTER);
  display.setFont(ArialMT_Plain_10);

  //BUG: (again) Touch channel interference
  touchAttachInterrupt(T0, tchTopMenuSelector, threshold);
  touchAttachInterrupt(T3, tchMainMenuSelector, threshold);
  touchAttachInterrupt(T6, tchIncrementVal, threshold);
  touchAttachInterrupt(T4, tchDecrementVal, threshold);

  redrawScreen();
}

void loop() {
  //TODO: Make freq and phase estimations
  dacWrite(25, amplitude[0]*WaveFormTable[wave_type[0]][iteratorA*frequency[0]]);
  dacWrite(26, amplitude[1]*WaveFormTable[wave_type[1]][iteratorB*frequency[1] + phase[1]]);
  //10us
  iteratorA++;
  iteratorB++;
  if (iteratorA*frequency[0] >= NUM_SAMPLES) iteratorA = 0; 
  if (iteratorB*frequency[1] + phase[1] >= NUM_SAMPLES) iteratorB = (int)(-phase[1]/frequency[1]); 
  //20op - 12us
  if(onTouch){ 
    long current_time = millis();
    if(current_time > last_touch_time + touch_threshold){
      switch(onTouchData){
        case 0: {       
          optTop++;
          if(optTop > 2) optTop = 0;
          if(optTop == 0 && optMain == 3) optMain = 2;  
          break;
        };
        case 1: {       
          optMain++;
          if(optMain > 3) optMain = 0;
          if(optTop == 0 && optMain > 2) optMain = 0; 
          break;
        };
        case 2: {       
          changeVal(false);
          break;
        };
        case 3: {       
          changeVal(true);
          break;
        };
      }
      last_touch_time = current_time;    
    }
    redrawScreen();
    onTouch = false;
  }
}

